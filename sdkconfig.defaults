## sdkconfig.defaults
```kconfig
# OneNET OTA 所需的回滚与分区配置
CONFIG_ESPTOOLPY_FLASHSIZE_16MB=y
CONFIG_ESPTOOLPY_FLASHSIZE="16MB"

CONFIG_PARTITION_TABLE_CUSTOM=y
CONFIG_PARTITION_TABLE_CUSTOM_FILENAME="partitions_16MB.csv"
CONFIG_PARTITION_TABLE_FILENAME="partitions_16MB.csv"
CONFIG_PARTITION_TABLE_OFFSET=0x8000
CONFIG_PARTITION_TABLE_MD5=y

CONFIG_BOOTLOADER_APP_ROLLBACK_ENABLE=y

CONFIG_MQTT_PROTOCOL_311=y
CONFIG_MQTT_TRANSPORT_SSL=y

CONFIG_MBEDTLS_CERTIFICATE_BUNDLE=y
CONFIG_MBEDTLS_CERTIFICATE_BUNDLE_DEFAULT_FULL=y

# OTA 只允许 HTTPS，禁止降级为明文 HTTP
# CONFIG_ESP_HTTPS_OTA_ALLOW_HTTP is not set

# mbedTLS 缓冲区使用 8 MB PSRAM，避免 TLS 分配失败
# CONFIG_MBEDTLS_INTERNAL_MEM_ALLOC is not set
CONFIG_MBEDTLS_EXTERNAL_MEM_ALLOC=y
```
